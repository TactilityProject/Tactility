## Tactility/Kconfig
```kconfig
# Kconfig file for Tactility example app
menu "Tactility App"
    config TT_DEVICE_NAME
        string "Device Name"
        default ""
        help
            Human-readable device name, including vendor (e.g. "M5Stack Cardputer")
    config TT_DEVICE_NAME_SIMPLE
        string "Device Name (simple)"
        default ""
        help
            Human-readable simple device name, excluding vendor (e.g. "Cardputer")
     config TT_DEVICE_VENDOR
         string "Device Vendor Name"
         default ""
         help
             Human-readable device vendor name (e.g. "LilyGO")
     config TT_DEVICE_ID
        string "Device Identifier"
        default ""
        help
            The name of the directory in Devices/
            See https://docs.tactilityproject.org for formatting guidance.
    config TT_APP_HUB_ONLINE
        bool "App Hub online features"
        default y
        help
            Allows App Hub to download the app catalog, install apps and update apps, and includes the Software app.
            When disabled, App Hub only lists the installed apps and uninstalls them.
            Devices without PSRAM disable it, as they don't have the memory for a TLS connection.
    config TT_FONT_DEFAULT_SIZE
        int "Default font size"
        default 14
        range 10 32
        help
            Default text font size in pixels. Other text and icon font sizes are derived from it.
    config TT_UI_SPACING
        int "Default UI spacing (%)"
        default 100
        range 0 100
        help
            Default spacing of widgets, from 0 (compact) to 100 (regular). Users can change it in the Appearance app.
    config TT_UI_SIZE
        int "Default UI size (%)"
        default 100
        range 0 100
        help
            Default size of widgets, from 0 (compact) to 100 (regular). Users can change it in the Appearance app.
    config TT_LAUNCHER_ICON_SIZE_SCALE
        int "Launcher icon size scale (%)"
        default 100
        range 25 400
        help
            Scale of the launcher icons relative to the default size, which is derived from the default font size.
    config TT_LAUNCHER_ICON_SPACING_SCALE
        int "Launcher icon spacing scale (%)"
        default 100
        range 0 400
        help
            Scale of the spacing between the launcher icons and around them, relative to the default spacing.
    config TT_LVGL_DRAW_BUFFER_LINES
        int "Lines per LVGL draw buffer"
        default 0
        range 0 4096
        help
            Number of display lines in an LVGL draw buffer. 0 uses a tenth of the vertical resolution.
            A smaller buffer uses less memory and needs more flushes.
    config TT_LVGL_PREFER_EXTERNAL_RAM
        bool "Prefer external RAM for LVGL draw buffers"
        default n
        help
            Allocates LVGL draw buffers from external RAM instead of DMA-capable internal RAM.
            Only safe for displays that never DMA directly from the draw buffer.
    config TT_AUTO_START_APP_ID
        string "Auto Start App ID"
        default ""
        help
            An application that gets automatically started from the launcher application.
            This is optional and can be left empty.
            The user can override it from a boot.properties file.
    # T-Deck device-related code was directly referenced from Tactility in a pull request.
    # This breaks other devices because the code does not exist in those implementations.
    # Until we move it out into a proper driver, we have to have pre-processor definition for that.
    config TT_TDECK_WORKAROUND
        bool "Temporary work-around until we fix the T-Deck keyboard and trackball settings"
        default n
    config TT_ROOT_PATH
        string "User Data Path"
        default "/data"
        help
            Mount path of the storage that holds the user data, e.g. "/data" or "/sdcard".
            "/data" is the internal flash partition. Any other path must be mounted by a device driver at runtime.
    config TT_SPLASH_DURATION
       int "Splash Duration (ms)"
       default 1000
       range 0 3000
       help
           The minimum time to show the splash screen in milliseconds.
           When set to 0, startup will continue to desktop as soon as boot operations are finished.
    choice TT_SYSTEM_BARS_PORTRAIT
        prompt "System bars layouts in portrait"
        default TT_SYSTEM_BARS_PORTRAIT_ANY
        help
            The system bars layouts that portrait orientations (including square ones) can use.
            "Any" lets the user's Appearance settings decide.
        config TT_SYSTEM_BARS_PORTRAIT_ANY
            bool "Any"
        config TT_SYSTEM_BARS_PORTRAIT_SPLIT
            bool "Split"
        config TT_SYSTEM_BARS_PORTRAIT_SIDE
            bool "Side"
    endchoice
    choice TT_SYSTEM_BARS_LANDSCAPE
        prompt "System bars layouts in landscape"
        default TT_SYSTEM_BARS_LANDSCAPE_ANY
        help
            The system bars layouts that landscape orientations can use.
            "Any" lets the user's Appearance settings decide.
        config TT_SYSTEM_BARS_LANDSCAPE_ANY
            bool "Any"
        config TT_SYSTEM_BARS_LANDSCAPE_SPLIT
            bool "Split"
        config TT_SYSTEM_BARS_LANDSCAPE_SIDE
            bool "Side"
    endchoice
    config TT_TOUCH_CALIBRATION_SUPPORTED
        bool "Set true when a touch screen calibration app should be included"
        default n
    config TT_TOUCH_CALIBRATION_REQUIRED
        bool "Set true when a touch screen calibration is required before the device is usable"
        default n
        depends on TT_TOUCH_CALIBRATION_SUPPORTED
    config TT_VIBRATION_ON_BOOT
        bool "Vibrate on boot"
        default n
        help
            Play a short vibration pulse when boot finishes, using the strength from the
            Vibration settings. No pulse is played when vibration is disabled there.
    config TT_LANGUAGE_SELECTION
        bool "Language selection"
        default y
        help
            Build the translations (French, Dutch, Spanish, German) into the firmware, with the Language
            settings app and the language page of the setup. When disabled, only English is built in,
            which saves flash space (about 90 KiB) on devices with small partitions.
endmenu
```
