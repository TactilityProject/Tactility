/dts-v1/;

#include <tactility/bindings/root.h>
#include <tactility/bindings/esp32_gpio.h>
#include <tactility/bindings/esp32_i2c.h>
#include <tactility/bindings/esp32_spi.h>

// Reference: https://www.waveshare.com/wiki/ESP32-S3-Touch-AMOLED-2.06

/ {
	compatible = "root";
	model = "Waveshare S3 Touch AMOLED 2.06";

	gpio0 {
		compatible = "espressif,esp32-gpio";
		gpio-count = <49>;
	};

	i2c_internal {
		compatible = "espressif,esp32-i2c";
		port = <I2C_NUM_0>;
		clock-frequency = <400000>;
		pin-sda = <&gpio0 18 GPIO_FLAG_NONE>;
		pin-scl = <&gpio0 17 GPIO_FLAG_NONE>;
	};

	// Display SPI disabled - let display BSP handle initialization with QSPI pins
	// display_spi: spi0 {
	// 	compatible = "espressif,esp32-spi";
	// 	host = <SPI2_HOST>;
	// 	pin-mosi = <&gpio0 11 GPIO_FLAG_NONE>;
	// 	pin-miso = <&gpio0 12 GPIO_FLAG_NONE>;
	// 	pin-sclk = <&gpio0 10 GPIO_FLAG_NONE>;
	// };

	sdcard_spi: spi1 {
		compatible = "espressif,esp32-spi";
		host = <SPI3_HOST>;
		pin-mosi = <&gpio0 36 GPIO_FLAG_NONE>;
		pin-miso = <&gpio0 37 GPIO_FLAG_NONE>;
		pin-sclk = <&gpio0 35 GPIO_FLAG_NONE>;
	};
};
