/dts-v1/;

#include <tactility/bindings/root.h>
#include <tactility/bindings/esp32_wifi_pinned.h>
#include <tactility/bindings/esp32_gpio.h>

/ {
	compatible = "root";
	model = "Generic ESP32 S3";

	wifi0 {
		compatible = "espressif,esp32-wifi-pinned";
	};

	gpio0 {
		compatible = "espressif,esp32-gpio";
		gpio-count = <49>;
	};
};
