## Firmware/Kconfig
```kconfig
# Kconfig file for Tactility example app
menu "Tactility App"
    config TT_DEVICE_NAME
        string "Device Name"
        default ""
        help
            Human-readable device name, including vendor (e.g. "M5Stack Cardputer")
    config TT_DEVICE_NAME_SIMPLE
        string "Device Name (simple)"
        default ""
        help
            Human-readable simple device name, excluding vendor (e.g. "Cardputer")
     config TT_DEVICE_VENDOR
         string "Device Vendor Name"
         default ""
         help
             Human-readable device vendor name (e.g. "LilyGO")
     config TT_DEVICE_ID
        string "Device Identifier"
        default ""
        help
            The name of the directory in Devices/
            See https://docs.tactilityproject.org for formatting guidance.
    config TT_LAUNCHER_APP_ID
        string "Launcher App ID"
        default "Launcher"
        help
            The applications that gives access to other application.
            This is the first thing that starts after the boot screen.
            The user can override it with a boot.properties file
    config TT_LVGL_FONT_SIZE_SMALL
        int "Small font size"
        default 10
        range 8 200
        help
            Small font size in pixels
    config TT_LVGL_FONT_SIZE_DEFAULT
        int "Default font size"
        default 14
        range 8 200
        help
            Default font size in pixels
    config TT_LVGL_FONT_SIZE_LARGE
        int "Large font size"
        default 18
        range 8 200
        help
            Large font size in pixels
    config TT_LVGL_STATUSBAR_ICON_SIZE
        int "Statusbar icon size"
        default 20
        range 0 200
        help
            Statusbar icon size in pixels
    config TT_LVGL_LAUNCHER_ICON_SIZE
        int "Launcher icon size"
        default 20
        range 0 200
        help
            Launcher icon size in pixels
    config TT_LVGL_SHARED_ICON_SIZE
        int "Shared icon size"
        default 16
        range 0 200
        help
            Shared icon size in pixels
    config TT_AUTO_START_APP_ID
        string "Auto Start App ID"
        default ""
        help
            An application that gets automatically started from the launcher application.
            This is optional and can be left empty.
            The user can override it from a boot.properties file.
    # T-Deck device-related code was directly referenced from Tactility in a pull request.
    # This breaks other devices because the code does not exist in those implementations.
    # Until we move it out into a proper driver, we have to have pre-processor definition for that.
    config TT_TDECK_WORKAROUND
        bool "Temporary work-around until we fix the T-Deck keyboard and trackball settings"
        default n
    config TT_USE_DEPRECATED_HAL
        bool "When set to false, it ensures an empty tt::hal::hardwareConfig is made automatically"
        default y
        help
            This allows for migrating projects that don't use the old HAL.
            When set to 'n', the project has an option to not depend on Tactility and can depend on TactilityKernel instead.
    choice TT_USER_DATA_LOCATION
        prompt "User Data Location"
        default TT_USER_DATA_LOCATION_INTERNAL
        help
            Where user data is stored on this device.
            "Internal Flash" assumes /data always exists.
            "SD Card" looks for the first mounted SD card at runtime and requires one to be present.
        config TT_USER_DATA_LOCATION_SD
            bool "SD Card"
        config TT_USER_DATA_LOCATION_INTERNAL
            bool "Internal Flash"
    endchoice
    config TT_SPLASH_DURATION
       int "Splash Duration (ms)"
       default 1000
       range 0 3000
       help
           The minimum time to show the splash screen in milliseconds.
           When set to 0, startup will continue to desktop as soon as boot operations are finished.
endmenu
```

## Libraries/esp_epaper/examples/esp32_wroom_4color/sdkconfig.defaults
```kconfig
# ESP32-WROOM-32D + 4-Color E-Paper Example Configuration
# Board: Good Display ESP32-WROOM-32D Development Kit
# Panel: GDEY037F51 (240x416 4-Color BWRY)

CONFIG_IDF_TARGET="esp32"
CONFIG_ESPTOOLPY_FLASHMODE_QIO=y
CONFIG_ESPTOOLPY_FLASHSIZE_4MB=y

# No PSRAM (ESP32-WROOM-32D doesn't have PSRAM)
CONFIG_SPIRAM=n

# CPU frequency
CONFIG_ESP_DEFAULT_CPU_FREQ_MHZ_240=y

# FreeRTOS
CONFIG_FREERTOS_HZ=1000

# LVGL Configuration
CONFIG_LV_COLOR_DEPTH_16=y
CONFIG_LV_MEM_CUSTOM=y
CONFIG_LV_MEMCPY_MEMSET_STD=y

# Fonts
CONFIG_LV_FONT_MONTSERRAT_14=y

# Main task stack
CONFIG_ESP_MAIN_TASK_STACK_SIZE=8192

# Log level
CONFIG_LOG_DEFAULT_LEVEL_INFO=y
```

## Libraries/esp_epaper/examples/esp32_wroom_generic/sdkconfig.defaults
```kconfig
# ESP32 target
CONFIG_IDF_TARGET="esp32"

# Flash size
CONFIG_ESPTOOLPY_FLASHSIZE_4MB=y
CONFIG_PARTITION_TABLE_SINGLE_APP_LARGE=y

# No PSRAM required (works with or without)
# CONFIG_ESP32_SPIRAM_SUPPORT is not set

# Stack size
CONFIG_ESP_MAIN_TASK_STACK_SIZE=8192

# Optimization
CONFIG_COMPILER_OPTIMIZATION_PERF=y

# Watchdog
CONFIG_ESP_TASK_WDT_TIMEOUT_S=10
```

## Libraries/esp_epaper/examples/esp32s3_epaper_154/sdkconfig.defaults
```kconfig
# ESP32-S3-ePaper-1.54 Example Configuration
# Board: Waveshare ESP32-S3-ePaper-1.54
# Panel: GDEY0154D67 (200x200 BW)

CONFIG_IDF_TARGET="esp32s3"
CONFIG_ESPTOOLPY_FLASHMODE_QIO=y
CONFIG_ESPTOOLPY_FLASHSIZE_4MB=y

# PSRAM (ESP32-S3-ePaper-1.54 has 2MB PSRAM)
CONFIG_SPIRAM=y
CONFIG_SPIRAM_MODE_QUAD=y
CONFIG_SPIRAM_SPEED_80M=y

# CPU frequency
CONFIG_ESP_DEFAULT_CPU_FREQ_MHZ_240=y

# FreeRTOS
CONFIG_FREERTOS_HZ=1000

# LVGL Configuration
CONFIG_LV_COLOR_DEPTH_16=y
CONFIG_LV_MEM_CUSTOM=y
CONFIG_LV_MEMCPY_MEMSET_STD=y

# Fonts
CONFIG_LV_FONT_MONTSERRAT_8=y
CONFIG_LV_FONT_MONTSERRAT_12=y
CONFIG_LV_FONT_MONTSERRAT_14=y
CONFIG_LV_FONT_MONTSERRAT_16=y

# Main task stack
CONFIG_ESP_MAIN_TASK_STACK_SIZE=8192
```

## Libraries/esp_epaper/examples/esp32s3_photopainter/sdkconfig.defaults
```kconfig
# ESP32-S3-PhotoPainter Example Configuration
# Board: Waveshare ESP32-S3-PhotoPainter
# Panel: GDEP073E01 (800x480 6-Color)

CONFIG_IDF_TARGET="esp32s3"
CONFIG_ESPTOOLPY_FLASHMODE_QIO=y
CONFIG_ESPTOOLPY_FLASHSIZE_16MB=y

# PSRAM (PhotoPainter has 8MB PSRAM - required for large framebuffer)
CONFIG_SPIRAM=y
CONFIG_SPIRAM_MODE_OCT=y
CONFIG_SPIRAM_SPEED_80M=y
CONFIG_SPIRAM_FETCH_INSTRUCTIONS=y
CONFIG_SPIRAM_RODATA=y

# CPU frequency
CONFIG_ESP_DEFAULT_CPU_FREQ_MHZ_240=y

# FreeRTOS
CONFIG_FREERTOS_HZ=1000

# LVGL Configuration
CONFIG_LV_COLOR_DEPTH_16=y
CONFIG_LV_MEM_CUSTOM=y
CONFIG_LV_MEMCPY_MEMSET_STD=y

# Fonts (larger fonts for bigger display)
CONFIG_LV_FONT_MONTSERRAT_12=y
CONFIG_LV_FONT_MONTSERRAT_14=y
CONFIG_LV_FONT_MONTSERRAT_16=y
CONFIG_LV_FONT_MONTSERRAT_18=y
CONFIG_LV_FONT_MONTSERRAT_20=y

# Main task stack (larger for dithering)
CONFIG_ESP_MAIN_TASK_STACK_SIZE=16384

# Log level
CONFIG_LOG_DEFAULT_LEVEL_INFO=y
```

## Libraries/espressif__spi_nand_flash/Kconfig
```kconfig
menu "SPI NAND Flash configuration"

    config NAND_FLASH_VERIFY_WRITE
        bool "Verify SPI NAND flash writes"
        default n
        help
            If this option is enabled, any time SPI NAND flash is written then the data will be read
            back and verified. This can catch hardware problems with SPI NAND flash, or flash which
            was not erased before verification.

    config NAND_FLASH_ENABLE_BDL
        bool "Enable Block Device Layer (BDL) support"
        depends on IDF_INIT_VERSION >= "6.0"
        default n
        help
            Enable Block Device Layer (BDL) support for SPI NAND Flash. This provides:
            - Standard esp_blockdev_t interface for layered architecture
            - Flash Block Device Layer (raw NAND flash access)
            - Wear-Leveling Block Device Layer (logical sector access with wear leveling)
            - Advanced layered API (spi_nand_flash_init_with_layers)
            When disabled, only the legacy API is available.
            When enabled, the legacy spi_nand_flash_init_device() is not available (returns
            ESP_ERR_NOT_SUPPORTED). Use spi_nand_flash_init_with_layers().

            Note: This option requires ESP-IDF >= 6.0 (esp_blockdev component).
            Enabling this on ESP-IDF < 6.0 will result in a build error.

    config NAND_ENABLE_STATS
        bool "Host test statistics enabled"
        depends on IDF_TARGET_LINUX
        default n
        help
            This option enables gathering host test statistics and SPI NAND flash wear levelling simulation.

endmenu
```
